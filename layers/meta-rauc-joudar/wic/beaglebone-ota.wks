## layers/meta-rauc-joudar/wic/beaglebone-ota.wks
```
bootloader --ptable gpt --append="console=ttyO0,115200n8"
part /boot --source bootimg-partition --sourceparams="loader=u-boot,script=boot.scr" --ondisk mmcblk0 --fstype=vfat --label bootA --active --align 4096 --size 100
part /boot --source bootimg-partition --sourceparams="loader=u-boot,script=boot.scr" --ondisk mmcblk0 --fstype=vfat --label bootB  --align 4096 --size 100
part / --source rootfs --ondisk mmcblk0 --fstype=ext4 --label rootfsA --align 4096
part / --source rootfs --ondisk mmcblk0 --fstype=ext4 --label rootfsB --align 4096
```
