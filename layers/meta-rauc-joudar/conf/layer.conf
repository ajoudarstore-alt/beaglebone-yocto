## layers/meta-rauc-joudar/conf/layer.conf
```bitbake
# We have a conf and classes directory, add to BBPATH
BBPATH .= ":${LAYERDIR}"

# We have recipes-* directories, add to BBFILES
BBFILES += "${LAYERDIR}/recipes-*/*/*.bb \
            ${LAYERDIR}/recipes-*/*/*.bbappend"

BBFILE_COLLECTIONS += "meta-rauc-joudar"
BBFILE_PATTERN_meta-rauc-joudar = "^${LAYERDIR}/"
BBFILE_PRIORITY_meta-rauc-joudar = "9"


LAYERDEPENDS_meta-rauc-joudar = "core rauc"
LAYERSERIES_COMPAT_meta-rauc-joudar = "scarthgap"
```

## meta-joudar-bsp/conf/layer.conf
```bitbake
# We have a conf and classes directory, add to BBPATH
BBPATH .= ":${LAYERDIR}"

# We have recipes-* directories, add to BBFILES
BBFILES += "${LAYERDIR}/recipes-*/*/*.bb \
            ${LAYERDIR}/recipes-*/*/*.bbappend"

BBFILE_COLLECTIONS += "meta-joudar-bsp"
BBFILE_PATTERN_meta-joudar-bsp = "^${LAYERDIR}/"
BBFILE_PRIORITY_meta-joudar-bsp = "6"

LAYERDEPENDS_meta-joudar-bsp = "core"
LAYERSERIES_COMPAT_meta-joudar-bsp = "scarthgap"
```

## meta-joudar-distro/conf/distro/joudar.conf
```bitbake
DISTRO = "joudar"
DISTRO_NAME = "joudar reference distribution"
DISTRO_VERSION = "1.0"
DISTRO_CODENAME = "scarthgap"

INIT_MANAGER = "systemd"
NO_RECOMMENDATIONS = "1"

DISTRO_FEATURES:append = " rauc"

# use one tmp directory
TCLIBCAPPEND = ""


PREMIRRORS ??= "\
bzr://.*/.*   http://downloads.yoctoproject.org/mirror/sources/ \n \
cvs://.*/.*   http://downloads.yoctoproject.org/mirror/sources/ \n \
git://.*/.*   http://downloads.yoctoproject.org/mirror/sources/ \n \
gitsm://.*/.* http://downloads.yoctoproject.org/mirror/sources/ \n \
hg://.*/.*    http://downloads.yoctoproject.org/mirror/sources/ \n \
osc://.*/.*   http://downloads.yoctoproject.org/mirror/sources/ \n \
p4://.*/.*    http://downloads.yoctoproject.org/mirror/sources/ \n \
svn://.*/.*   http://downloads.yoctoproject.org/mirror/sources/ \n"

MIRRORS =+ "\
ftp://.*/.*      http://downloads.yoctoproject.org/mirror/sources/ \n \
http://.*/.*     http://downloads.yoctoproject.org/mirror/sources/ \n \
https://.*/.*    http://downloads.yoctoproject.org/mirror/sources/ \n"

#remove gpl v3
require conf/distro/include/no-gplv3.inc

#security flags
require conf/distro/include/security_flags.inc

#Distro features
DISTRO_FEATURES = "\
    acl\ 
    bluetooth \
    ext2 \
    ipv4 \
    ipv6 \
    usbgadget \
    usbhost \
    wifi \
    xattr \
    zeroconf \
    pci \
    vfat \
    seccomp \
    systemd \
"
```

## meta-joudar-distro/conf/layer.conf
```bitbake
# We have a conf and classes directory, add to BBPATH
BBPATH .= ":${LAYERDIR}"

# We have recipes-* directories, add to BBFILES
BBFILES += "${LAYERDIR}/recipes-*/*/*.bb \
            ${LAYERDIR}/recipes-*/*/*.bbappend"

BBFILE_COLLECTIONS += "meta-joudar-distro"
BBFILE_PATTERN_meta-joudar-distro = "^${LAYERDIR}/"
BBFILE_PRIORITY_meta-joudar-distro = "6"

LAYERDEPENDS_meta-joudar-distro = "core rauc"
LAYERSERIES_COMPAT_meta-joudar-distro = "scarthgap"
```

## meta-joudar/conf/layer.conf
```bitbake
# We have a conf and classes directory, add to BBPATH
BBPATH .= ":${LAYERDIR}"

# We have recipes-* directories, add to BBFILES
BBFILES += "${LAYERDIR}/recipes-*/*/*.bb \
            ${LAYERDIR}/recipes-*/*/*.bbappend"

BBFILE_COLLECTIONS += "meta-joudar"
BBFILE_PATTERN_meta-joudar = "^${LAYERDIR}/"
BBFILE_PRIORITY_meta-joudar = "6"

LAYERDEPENDS_meta-joudar = "core"
LAYERSERIES_COMPAT_meta-joudar = "scarthgap"
```
